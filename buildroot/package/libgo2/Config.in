## buildroot/package/libgo2/Config.in
```kconfig
config BR2_PACKAGE_LIBGO2
	bool "LIBGO2"
	help
	  Simple DirectMedia Layer - SDL is a library that allows
	  programs portable low level access to a video framebuffer,
	  audio output, mouse, and keyboard.

	  http://www.libsdl.org/

if BR2_PACKAGE_LIBGO2

endif
```
